## board/boundary/nexo/Kconfig
```kconfig
if TARGET_NEXO

config SYS_CPU
	default "armv7"

config SYS_BOARD
	default "nexo"

config SYS_VENDOR
	default "boundary"

config SYS_SOC
	default "mx6"

config SYS_CONFIG_NAME
	default "nexo"

config ENV_WLMAC
	bool
	default	y

source "board/boundary/common/Kconfig"

endif
```
